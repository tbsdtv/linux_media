## drivers/media/pci/tbscapture/Kconfig
```kconfig
config TBS_PCIE_CAP
	tristate "TBS PCIe HDMI/SDI capture cards"
	depends on PCI && I2C && DVB_CORE
	default m if !MEDIA_SUBDRV_AUTOSELECT

	help
	  Support for TBS PCIe HDMI/SDI capture cards

	  Say Y if you own such a device and want to use it.
```

## drivers/media/pci/tbscapture2/Kconfig
```kconfig
config TBS_PCIE2_CAP
	tristate "TBS PCIex2 HDMI capture cards"
	depends on X86 && PCI && I2C && DVB_CORE
	default m if !MEDIA_SUBDRV_AUTOSELECT

	help
	  Support for TBS PCIex2 HDMI capture cards

	  Say Y if you own such a device and want to use it.
```

## drivers/media/pci/tbsci/Kconfig
```kconfig
config TBS_PCIE_CI
	tristate "TBS PCIe ci cards"
	depends on PCI && I2C && DVB_CORE
	default m if !MEDIA_SUBDRV_AUTOSELECT

	help
	  Support for TBS PCIe ci cards

	  Say Y if you own such a device and want to use it.
```

## drivers/media/pci/tbsecp3/Kconfig
```kconfig
config DVB_TBSECP3
	tristate "TBS ECP3 FPGA based cards"
	depends on DVB_CORE && PCI && I2C
	select I2C_ALGOBIT
	select DVB_TAS2101 if MEDIA_SUBDRV_AUTOSELECT
	select MEDIA_TUNER_AV201X if MEDIA_SUBDRV_AUTOSELECT
	select DVB_STV091X if MEDIA_SUBDRV_AUTOSELECT
	select MEDIA_TUNER_STV6120 if MEDIA_SUBDRV_AUTOSELECT
	select DVB_SI2168 if MEDIA_SUBDRV_AUTOSELECT
	select MEDIA_TUNER_SI2157 if MEDIA_SUBDRV_AUTOSELECT
	select DVB_MXL58X if MEDIA_SUBDRV_AUTOSELECT
	select DVB_SI2183 if MEDIA_SUBDRV_AUTOSELECT
	select DVB_MN88436 if MEDIA_SUBDRV_AUTOSELECT
	select MEDIA_TUNER_MXL603 if MEDIA_SUBDRV_AUTOSELECT
	select DVB_GX1503 if MEDIA_SUBDRV_AUTOSELECT
	select DVB_MTV23X if MEDIA_SUBDRV_AUTOSELECT
	select DVB_TAS2971 if MEDIA_SUBDRV_AUTOSELECT
	select DVB_STID135 if MEDIA_SUBDRV_AUTOSELECT
	select DVB_M88RS6060 if MEDIA_SUBDRV_AUTOSELECT
	select MEDIA_TUNER_RDA5816 if MEDIA_SUBDRV_AUTOSELECT	
	select MEDIA_TUNER_R850 if MEDIA_SUBDRV_AUTOSELECT
	help
	  Support for cards with TBS ECP3 FPGA based PCIe bridge.

	  Say Y or M if you own such a device and want to use it.
	  If unsure say N.
```

## drivers/media/pci/tbsmod/Kconfig
```kconfig
config TBS_PCIE_MOD
	tristate "TBS PCIe mod cards"
	depends on PCI && I2C && DVB_CORE
	default m if !MEDIA_SUBDRV_AUTOSELECT

	help
	  Support for TBS PCIe mod cards

	  Say Y if you own such a device and want to use it.
```
